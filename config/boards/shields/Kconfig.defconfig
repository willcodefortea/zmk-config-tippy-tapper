## config/boards/shields/Kconfig.defconfig
```kconfig
if SHIELD_LEFT

config ZMK_KEYBOARD_NAME
    default "TippyTapper"

config ZMK_SPLIT_ROLE_CENTRAL
    default y

endif

if SHIELD_LEFT || SHIELD_RIGHT

config ZMK_SPLIT
    default y

endif
```

## config/boards/shields/tippy_tapper/Kconfig.defconfig
```kconfig
if SHIELD_TIPPY_TAPPER_LEFT

config ZMK_KEYBOARD_NAME
    default "TippyTapper"

config ZMK_SPLIT_ROLE_CENTRAL
    default y

endif

if SHIELD_TIPPY_TAPPER_LEFT || SHIELD_TIPPY_TAPPER_RIGHT

config ZMK_SPLIT
    default y

endif
```

## config/boards/shields/tippy_tapper/Kconfig.shield
```kconfig
config SHIELD_TIPPY_TAPPER_DONGLE
    def_bool $(shields_list_contains,tippy_tapper_dongle)

config SHIELD_TIPPY_TAPPER_LEFT
    def_bool $(shields_list_contains,tippy_tapper_left)

config SHIELD_TIPPY_TAPPER_RIGHT
    def_bool $(shields_list_contains,tippy_tapper_right)
```
